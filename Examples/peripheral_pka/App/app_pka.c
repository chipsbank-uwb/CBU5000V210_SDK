/**
 * @file app_pka.c
 * @brief Implementation file for example usages of the Trng driver.
 * @details 3 examples:
 *          Get an RN with hardware entropy (Noise)
 *          Get an RN with user-provided seed (Nonce)
 *          Run healthcheck on hardware entropy source (KAT)
 * @author Chipsbank
 * @date 2024
 */
//-------------------------------
// INCLUDE
//-------------------------------
#include "app_pka.h"
#include "CB_pka.h"
#include "string.h"

//-------------------------------
// CONFIGURATION SECTION
//-------------------------------
#define APP_PKA_UARTPRINT_ENABLE APP_TRUE

#if (APP_PKA_UARTPRINT_ENABLE == APP_TRUE)
  #include "app_uart.h"
  #define app_pka_print(...) app_uart_printf(__VA_ARGS__)
#else
  #define app_pka_print(...)
#endif

//-------------------------------
// DEFINE
//-------------------------------

//-------------------------------
// ENUM
//-------------------------------
//-------------------------------
// STRUCT/UNION SECTION
//-------------------------------
//-------------------------------
// GLOBAL VARIABLE SECTION
//------------------------------
static uint8_t signed_hash_2[128] = {0};
//-------------------------------
// FUNCTION PROTOTYPE SECTION
//-------------------------------
static void app_pka_rsa_precompute(const stPkaRsaKey* const key, stPkaPrecompVals* const precomputed);
//-------------------------------
// FUNCTION BODY SECTION
//-------------------------------
#if defined(__clang__)
    #pragma clang diagnostic push
    #pragma clang diagnostic ignored "-Wvla"
#endif

/**
 * @brief Example usage of signing api.
 * @detail 
 * This example hashed the binary with SHA-256, and generated an rsa-1024 keypair with openssl. These are outputted
 * in big-endian, so the reverse API is used to make them little-endian friendly. The output signature is copied to a
 * global in this example so the verification example can run properly. Remember to ALWAYS wrap the PKA API around
 * a Init() and Deinit(). This is compulsory.
 */
void app_pka_encrypt_rsa1024(void) 
{
    const uint8_t input_hash[] = {0x4c, 0x50, 0xfb, 0x0c, 0x4b, 0xba, 0x60, 0x58, 0xc7, 0x5c, 0x68,
                                  0xff, 0x64, 0xa8, 0xc9, 0xda, 0x4b, 0xb3, 0x16, 0xbe, 0xb2, 0xce,
                                  0xc5, 0xca, 0x56, 0x39, 0x8a, 0x2f, 0x48, 0xb6, 0x6c, 0xe1};
    /**
     * output straight from openssl is big-endian
     */
    stPkaRsaKey privatekey = {
        .Modulus = {0xaa, 0xe4, 0x37, 0xa0, 0x34, 0x41, 0xce, 0xfd, 0x09, 0xee, 0x91, 0xc7, 0x91, 0x65, 0x35, 0xb3,
                    0x0f, 0xf3, 0xf2, 0xdf, 0x62, 0x82, 0xd5, 0x70, 0x84, 0xff, 0xaf, 0xa0, 0x94, 0x0a, 0x7e, 0x45,
                    0x9b, 0x2f, 0xe3, 0x75, 0xf4, 0xde, 0xac, 0x60, 0x9e, 0xea, 0x08, 0xa8, 0xe2, 0xb6, 0x41, 0x58,
                    0x50, 0xb3, 0xaf, 0x5c, 0xd2, 0xbb, 0x56, 0x88, 0x9d, 0xc1, 0x5e, 0xec, 0x60, 0x12, 0x84, 0x0f,
                    0x91, 0xee, 0xa9, 0xcd, 0xa3, 0x26, 0xf3, 0xc9, 0xc4, 0x8c, 0xbf, 0xb0, 0x41, 0xa1, 0x7f, 0xa1,
                    0x9e, 0x14, 0xe9, 0xe6, 0x34, 0x7d, 0xa4, 0xf7, 0x9d, 0x93, 0xb5, 0x52, 0xa1, 0x31, 0xd1, 0x4b,
                    0xed, 0xf4, 0x54, 0x30, 0x9f, 0xba, 0x26, 0xd4, 0x33, 0x78, 0x64, 0x9b, 0x3a, 0xe5, 0x2f, 0x34,
                    0x20, 0xca, 0x23, 0x50, 0x7d, 0x5e, 0xc6, 0x74, 0x6b, 0xde, 0x56, 0x0c, 0xb1, 0xf5, 0xa7, 0x61},
        .Exp = {0x39, 0x9d, 0xd8, 0x63, 0x5b, 0x3b, 0x14, 0xde, 0x9b, 0x8a, 0xa3, 0xfb, 0xf5, 0x39, 0x7a, 0x71,
                0x74, 0xdf, 0x7a, 0xf3, 0x75, 0xf3, 0x46, 0xa3, 0x39, 0x34, 0x3b, 0xb2, 0x98, 0x37, 0x31, 0x7b,
                0xa6, 0x66, 0xee, 0xf9, 0xc6, 0x25, 0x8d, 0x58, 0xc6, 0x3b, 0x81, 0xcf, 0xef, 0x20, 0x23, 0xc7,
                0xf2, 0xed, 0xa2, 0x22, 0x59, 0xaa, 0x6f, 0xf2, 0x7f, 0xbd, 0xc2, 0x93, 0x4f, 0x90, 0xee, 0x95,
                0x04, 0x1a, 0xd8, 0x80, 0xb3, 0xbb, 0xf7, 0x7f, 0x4b, 0x44, 0x7e, 0xc0, 0xd5, 0x15, 0x0e, 0x03,
                0xd6, 0xfd, 0xd0, 0xab, 0x1b, 0x7f, 0xb3, 0x69, 0xb4, 0xfa, 0xc1, 0xbf, 0x7b, 0x1b, 0xcb, 0x0a,
                0xb9, 0xd6, 0x29, 0x03, 0x0d, 0x03, 0xbf, 0x06, 0x42, 0x6e, 0xd9, 0x30, 0x18, 0x82, 0x78, 0x32,
                0x6d, 0x73, 0x4c, 0x94, 0xb8, 0x8a, 0x22, 0x3e, 0x7b, 0xb1, 0xd5, 0x7e, 0x6c, 0xe8, 0x00, 0x01},
        .ModSize = 128, // in byte
    };   
    uint8_t out[privatekey.ModSize];

    CB_PKA_Init();
    CB_PKA_Reverse(privatekey.Modulus, privatekey.ModSize);
    CB_PKA_Reverse(privatekey.Exp, privatekey.ModSize);
    CB_PKA_RsaSign(input_hash, sizeof(input_hash) / sizeof(input_hash[0]), out, &privatekey);
    memcpy(signed_hash_2, out, sizeof(signed_hash_2));
    app_pka_print("\n");
    CB_PKA_Deinit();
}

#if defined(__clang__)
    #pragma clang diagnostic pop
#endif

/**
 * @brief Example usage of verification API.
 * @detail Get the public key from the generated private key used for signing. Reverse them if they are big-endian
 * originally. The verification API will spit out the "decrypted" hash, which should be the same as the original if
 * the signature was uncorrupted or unchanged (high integrity). We use memcmp here to verify this.
 */
void app_pka_verify_rsa1024(void) 
{
    uint8_t output[128] = {0};
    const uint8_t input_hash[] = {0x4c, 0x50, 0xfb, 0x0c, 0x4b, 0xba, 0x60, 0x58, 0xc7, 0x5c, 0x68,
                                  0xff, 0x64, 0xa8, 0xc9, 0xda, 0x4b, 0xb3, 0x16, 0xbe, 0xb2, 0xce,
                                  0xc5, 0xca, 0x56, 0x39, 0x8a, 0x2f, 0x48, 0xb6, 0x6c, 0xe1};
    stPkaRsaKey publickey = {
        .Modulus = {0xaa, 0xe4, 0x37, 0xa0, 0x34, 0x41, 0xce, 0xfd, 0x09, 0xee, 0x91, 0xc7, 0x91, 0x65, 0x35, 0xb3,
                    0x0f, 0xf3, 0xf2, 0xdf, 0x62, 0x82, 0xd5, 0x70, 0x84, 0xff, 0xaf, 0xa0, 0x94, 0x0a, 0x7e, 0x45,
                    0x9b, 0x2f, 0xe3, 0x75, 0xf4, 0xde, 0xac, 0x60, 0x9e, 0xea, 0x08, 0xa8, 0xe2, 0xb6, 0x41, 0x58,
                    0x50, 0xb3, 0xaf, 0x5c, 0xd2, 0xbb, 0x56, 0x88, 0x9d, 0xc1, 0x5e, 0xec, 0x60, 0x12, 0x84, 0x0f,
                    0x91, 0xee, 0xa9, 0xcd, 0xa3, 0x26, 0xf3, 0xc9, 0xc4, 0x8c, 0xbf, 0xb0, 0x41, 0xa1, 0x7f, 0xa1,
                    0x9e, 0x14, 0xe9, 0xe6, 0x34, 0x7d, 0xa4, 0xf7, 0x9d, 0x93, 0xb5, 0x52, 0xa1, 0x31, 0xd1, 0x4b,
                    0xed, 0xf4, 0x54, 0x30, 0x9f, 0xba, 0x26, 0xd4, 0x33, 0x78, 0x64, 0x9b, 0x3a, 0xe5, 0x2f, 0x34,
                    0x20, 0xca, 0x23, 0x50, 0x7d, 0x5e, 0xc6, 0x74, 0x6b, 0xde, 0x56, 0x0c, 0xb1, 0xf5, 0xa7, 0x61},
        .Exp = {0x00, 0x01, 0x00, 0x01},
        .ModSize = 128,
    };
    
    CB_PKA_Init();
    CB_PKA_Reverse(publickey.Modulus, publickey.ModSize);
    CB_PKA_Reverse(publickey.Exp, 4);
    CB_PKA_RsaVerify(signed_hash_2, sizeof(signed_hash_2) / sizeof(signed_hash_2[0]), output, &publickey);

    int cmp = memcmp(output, input_hash, sizeof(input_hash));

    app_pka_print("Verified success: %d\n\n", cmp == 0);

    CB_PKA_Deinit();
}

/**
 * @brief Precomputation of mathematical variables used in rsa encryption/decryption.
 * @detail Simple usage of the relevant API. This function is a helper, so it's not wrapped in Init() and Deinit(), but
 * remember, if these are called by themselves, it MUST BE WRAPPED.
 */
void app_pka_rsa_precompute(const stPkaRsaKey* const key, stPkaPrecompVals* const precomputed) 
{
    // Usually you should call Init and Deinit, but this is just an example helper to show API usage
    CB_PKA_CalcRInv(key->Modulus, key->ModSize, precomputed->RInv);
    CB_PKA_CalcMp(key->Modulus, key->ModSize, precomputed->RInv, precomputed->Mp);
    CB_PKA_CalcRSqr(key->Modulus, key->ModSize, precomputed->RInv, precomputed->RSqr);
}

/**
 * @brief Signing and verification using API that takes precomputed values.
 * @detail Normal APIs don't require the precomputed values, but they take much more cpu cycles. Since precomputation
 * only use public components of keypairs and they stay constant so long as the keypair is the same, we provided the 
 * choice to save these cpu cycles.
 */
void app_pka_rsa_sign_and_verify_precompute(void) 
{
    const uint8_t input_hash[] = {0x4c, 0x50, 0xfb, 0x0c, 0x4b, 0xba, 0x60, 0x58, 0xc7, 0x5c, 0x68,
                                  0xff, 0x64, 0xa8, 0xc9, 0xda, 0x4b, 0xb3, 0x16, 0xbe, 0xb2, 0xce,
                                  0xc5, 0xca, 0x56, 0x39, 0x8a, 0x2f, 0x48, 0xb6, 0x6c, 0xe1};
    stPkaRsaKey privatekey = {
        .Modulus = {0xaa, 0xe4, 0x37, 0xa0, 0x34, 0x41, 0xce, 0xfd, 0x09, 0xee, 0x91, 0xc7, 0x91, 0x65, 0x35, 0xb3,
                    0x0f, 0xf3, 0xf2, 0xdf, 0x62, 0x82, 0xd5, 0x70, 0x84, 0xff, 0xaf, 0xa0, 0x94, 0x0a, 0x7e, 0x45,
                    0x9b, 0x2f, 0xe3, 0x75, 0xf4, 0xde, 0xac, 0x60, 0x9e, 0xea, 0x08, 0xa8, 0xe2, 0xb6, 0x41, 0x58,
                    0x50, 0xb3, 0xaf, 0x5c, 0xd2, 0xbb, 0x56, 0x88, 0x9d, 0xc1, 0x5e, 0xec, 0x60, 0x12, 0x84, 0x0f,
                    0x91, 0xee, 0xa9, 0xcd, 0xa3, 0x26, 0xf3, 0xc9, 0xc4, 0x8c, 0xbf, 0xb0, 0x41, 0xa1, 0x7f, 0xa1,
                    0x9e, 0x14, 0xe9, 0xe6, 0x34, 0x7d, 0xa4, 0xf7, 0x9d, 0x93, 0xb5, 0x52, 0xa1, 0x31, 0xd1, 0x4b,
                    0xed, 0xf4, 0x54, 0x30, 0x9f, 0xba, 0x26, 0xd4, 0x33, 0x78, 0x64, 0x9b, 0x3a, 0xe5, 0x2f, 0x34,
                    0x20, 0xca, 0x23, 0x50, 0x7d, 0x5e, 0xc6, 0x74, 0x6b, 0xde, 0x56, 0x0c, 0xb1, 0xf5, 0xa7, 0x61},
        .Exp = {0x39, 0x9d, 0xd8, 0x63, 0x5b, 0x3b, 0x14, 0xde, 0x9b, 0x8a, 0xa3, 0xfb, 0xf5, 0x39, 0x7a, 0x71,
                0x74, 0xdf, 0x7a, 0xf3, 0x75, 0xf3, 0x46, 0xa3, 0x39, 0x34, 0x3b, 0xb2, 0x98, 0x37, 0x31, 0x7b,
                0xa6, 0x66, 0xee, 0xf9, 0xc6, 0x25, 0x8d, 0x58, 0xc6, 0x3b, 0x81, 0xcf, 0xef, 0x20, 0x23, 0xc7,
                0xf2, 0xed, 0xa2, 0x22, 0x59, 0xaa, 0x6f, 0xf2, 0x7f, 0xbd, 0xc2, 0x93, 0x4f, 0x90, 0xee, 0x95,
                0x04, 0x1a, 0xd8, 0x80, 0xb3, 0xbb, 0xf7, 0x7f, 0x4b, 0x44, 0x7e, 0xc0, 0xd5, 0x15, 0x0e, 0x03,
                0xd6, 0xfd, 0xd0, 0xab, 0x1b, 0x7f, 0xb3, 0x69, 0xb4, 0xfa, 0xc1, 0xbf, 0x7b, 0x1b, 0xcb, 0x0a,
                0xb9, 0xd6, 0x29, 0x03, 0x0d, 0x03, 0xbf, 0x06, 0x42, 0x6e, 0xd9, 0x30, 0x18, 0x82, 0x78, 0x32,
                0x6d, 0x73, 0x4c, 0x94, 0xb8, 0x8a, 0x22, 0x3e, 0x7b, 0xb1, 0xd5, 0x7e, 0x6c, 0xe8, 0x00, 0x01},
        .ModSize = 128,
    };
    uint8_t signed_output[128] = {0};

    stPkaPrecompVals precomputed;
    CB_PKA_Init();
    CB_PKA_Reverse(privatekey.Modulus, privatekey.ModSize);
    CB_PKA_Reverse(privatekey.Exp, privatekey.ModSize);
    app_pka_rsa_precompute(&privatekey, &precomputed);
    CB_PKA_RsaSignP(input_hash, sizeof(input_hash)/sizeof(input_hash[0]), &precomputed, signed_output, &privatekey);

    uint8_t verify_out[128];
    stPkaRsaKey publickey = {
        .Modulus = {0xaa, 0xe4, 0x37, 0xa0, 0x34, 0x41, 0xce, 0xfd, 0x09, 0xee, 0x91, 0xc7, 0x91, 0x65, 0x35, 0xb3,
                    0x0f, 0xf3, 0xf2, 0xdf, 0x62, 0x82, 0xd5, 0x70, 0x84, 0xff, 0xaf, 0xa0, 0x94, 0x0a, 0x7e, 0x45,
                    0x9b, 0x2f, 0xe3, 0x75, 0xf4, 0xde, 0xac, 0x60, 0x9e, 0xea, 0x08, 0xa8, 0xe2, 0xb6, 0x41, 0x58,
                    0x50, 0xb3, 0xaf, 0x5c, 0xd2, 0xbb, 0x56, 0x88, 0x9d, 0xc1, 0x5e, 0xec, 0x60, 0x12, 0x84, 0x0f,
                    0x91, 0xee, 0xa9, 0xcd, 0xa3, 0x26, 0xf3, 0xc9, 0xc4, 0x8c, 0xbf, 0xb0, 0x41, 0xa1, 0x7f, 0xa1,
                    0x9e, 0x14, 0xe9, 0xe6, 0x34, 0x7d, 0xa4, 0xf7, 0x9d, 0x93, 0xb5, 0x52, 0xa1, 0x31, 0xd1, 0x4b,
                    0xed, 0xf4, 0x54, 0x30, 0x9f, 0xba, 0x26, 0xd4, 0x33, 0x78, 0x64, 0x9b, 0x3a, 0xe5, 0x2f, 0x34,
                    0x20, 0xca, 0x23, 0x50, 0x7d, 0x5e, 0xc6, 0x74, 0x6b, 0xde, 0x56, 0x0c, 0xb1, 0xf5, 0xa7, 0x61},
        .Exp = {0x00, 0x01, 0x00, 0x01},
        .ModSize = 128,
    };
    
    CB_PKA_Reverse(publickey.Modulus, publickey.ModSize);
    CB_PKA_Reverse(publickey.Exp, 4);
    CB_PKA_RsaVerifyP(signed_output, 128, &precomputed, verify_out, &publickey);
    int cmp = memcmp(verify_out, input_hash, sizeof(input_hash));
    CB_PKA_Deinit();

    app_pka_print("input_hash:\n");
    for(uint8_t i=0;i<sizeof(input_hash);i++)
    {
      app_pka_print("%02x ", input_hash[i]);
      if((i+1) % 16 == 0)
      {
        app_pka_print("\n");
      }
    }
    app_pka_print("\n\n");

    app_pka_print("signed_output:\n");
    for(uint8_t i=0;i<sizeof(signed_output);i++)
    {
      app_pka_print("%02x ", signed_output[i]);
      if((i+1) % 16 == 0)
      {
        app_pka_print("\n");
      }
    }
      app_pka_print("\n\n");

    app_pka_print("Verification output:\n");
    for(uint8_t i=0; i<sizeof(verify_out); i++) 
    {
      app_pka_print("%02x ", verify_out[i]);
      if((i+1) % 16 == 0) 
      {
        app_pka_print("\n");
      }
    }
    app_pka_print("\n\n");

    app_pka_print("Verified success: %d\n", cmp == 0);
}

/**
 * @brief Main function to execute PKA-related operations and tests.
 *
 * This function initializes the UART for debugging purposes and then proceeds 
 * to perform RSA encryption, verification, and precomputation of signing and verification 
 * using the PKA (Public key Accelerator) module. These operations serve as examples 
 * of how to use the PKA module at the application level.
 */
void app_peripheral_pka_init(void)
{
    // Initialize UART for debugging: GPIO00-RX, GPIO01-TX, BPR=115200, Stop bit = 1, BitOrder = LSB, Parity = NONE
    app_uart_init();                             
    
    // Indicate power-on reset
    app_pka_print("\n\nPower-on reset\n");     
    
    // Precompute values for RSA signing and verification
    app_pka_rsa_sign_and_verify_precompute();
    
}
